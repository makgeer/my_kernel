/* Линкер-скрипт для пользовательской программы hello.
   Базовый адрес = USER_CODE_BASE ядра (0x400000000000).
   Адреса сегментов берутся из ELF самим загрузчиком (src/elf.rs),
   так что они не зависят от адресов ядра. */

ENTRY(_start)

SECTIONS
{
    . = 0x400000000000;

    .text : {
        *(.text*)
    }

    .rodata : {
        *(.rodata*)
    }

    .data : {
        *(.data*)
    }

    .bss : {
        *(.bss*)
    }
}
