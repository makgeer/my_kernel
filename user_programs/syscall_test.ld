/* Линкер-скрипт для пользовательской программы syscall_test.
   Базовый адрес = USER_CODE_BASE ядра (0x400000000000).

   КЛЮЧЕВОЕ ОТЛИЧИЕ от hello.ld: .data выравнивается по границе
   страницы (ALIGN(0x1000)) и попадает в ОТДЕЛЬНЫЙ PT_LOAD сегмент
   с флагом W (writable) — это проверка загрузчика ELF на случай
   нескольких PT_LOAD с разными правами доступа. .text/.rodata —
   в первом сегменте R E, .data/.bss — во втором RW. */

ENTRY(_start)

SECTIONS
{
    . = 0x400000000000;

    .text : {
        *(.text*)
    }

    .rodata : {
        *(.rodata*)
    }

    /* Начинаем новый сегмент с границы страницы: следующие секции
       получат отдельный PT_LOAD (RW). Без ALIGN всё слиплось бы
       в один LOAD и буфер key не был бы writable. */
    . = ALIGN(0x1000);

    .data : {
        *(.data*)
    }

    .bss : {
        *(.bss*)
    }
}